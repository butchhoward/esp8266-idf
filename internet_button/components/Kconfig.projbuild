## internet_button/components/Kconfig.projbuild
```kconfig
menu "Button Connection Configuration"
    config BUTTON_WIFI_SSID
        string "WiFi SSID"
        default "myssid"
        help
            SSID (network name) for the example to connect to.

    config BUTTON_DEFINE_WIFI_PASSWORD
        bool "Define a password for WiFi?"
        default n

    config BUTTON_WIFI_PASSWORD
        depends on BUTTON_DEFINE_WIFI_PASSWORD
        string "WiFi Password"
        help
            WiFi password (WPA or WPA2) for the example to use.
            Can be left blank if the network has no security set.

    config BUTTON_MDNS_HOSTNAME
        string "mDNS Name to use for device"
        default "lamp"

    config BUTTON_MDNS_INSTANCE
        string "mDNS Description to use for the device"
        default "the office lamp"

endmenu
```

## internet_button/sdkconfig.defaults
```kconfig
CONFIG_ESPTOOLPY_PORT="/dev/cu.SLAB_USBtoUART"
CONFIG_ESPTOOLPY_FLASHFREQ_80M=y
CONFIG_ESPTOOLPY_FLASHFREQ="80m"
CONFIG_ESPTOOLPY_FLASHSIZE_4MB=y
CONFIG_SPI_FLASH_SIZE=0x400000

CONFIG_LWIP_IPV6=y
CONFIG_ENABLE_MDNS=y
CONFIG_MDNS_MAX_SERVICES=10
CONFIG_MDNS_STACKSIZE=4096

CONFIG_BUTTON_WIFI_SSID="HOWARDHOMENET"
CONFIG_BUTTON_MDNS_HOSTNAME="lamp"
CONFIG_BUTTON_MDNS_INSTANCE="Office Lamp"
```
